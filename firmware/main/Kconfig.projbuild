## firmware/main/Kconfig.projbuild
```kconfig
menu "Humidity Monitor Configuration"

    menu "WiFi"

        config WIFI_SSID
            string "WiFi SSID"
            default "myssid"
            help
                SSID (network name) to connect to.

        config WIFI_PASSWORD
            string "WiFi Password"
            default "mypassword"
            help
                WiFi password (WPA or WPA2).

        choice WIFI_SAE_MODE
            prompt "WPA3 SAE mode selection"
            default WIFI_WPA3_SAE_PWE_BOTH
            help
                Select mode for SAE as Hunt and Peck, H2E or both.
            config WIFI_WPA3_SAE_PWE_HUNT_AND_PECK
                bool "HUNT AND PECK"
            config WIFI_WPA3_SAE_PWE_HASH_TO_ELEMENT
                bool "H2E"
                depends on ESP_WIFI_ENABLE_SAE_H2E
            config WIFI_WPA3_SAE_PWE_BOTH
                bool "BOTH"
                depends on ESP_WIFI_ENABLE_SAE_H2E
        endchoice

        config WIFI_PW_ID
            string "PASSWORD IDENTIFIER"
            depends on WIFI_WPA3_SAE_PWE_HASH_TO_ELEMENT || WIFI_WPA3_SAE_PWE_BOTH
            default ""
            help
                password identifier for SAE H2E

        config WIFI_MAX_RETRIES
            int "Maximum retries"
            default 30
            help
                Maximum number of reconnection attempts before giving up.

        config WIFI_MAX_RETRY_DELAY_MS
            int "Maximum retry delay cap"
            default 120000
            help
                Maximum delay cap (in ms) for exponential backoff retry.

        choice WIFI_SCAN_AUTH_MODE_THRESHOLD
            prompt "WiFi Scan auth mode threshold"
            default WIFI_AUTH_WPA2_PSK
            help
                The weakest authmode to accept in the scan mode.
                This value defaults to WIFI_AUTH_WPA2_PSK in case password is present and WIFI_AUTH_OPEN is used.
                Please select WIFI_AUTH_WEP/WIFI_AUTH_WPA_PSK in case AP is operating in WEP/WPA mode.

            config WIFI_AUTH_OPEN
                bool "OPEN"
            config WIFI_AUTH_WEP
                bool "WEP"
            config WIFI_AUTH_WPA_PSK
                bool "WPA PSK"
            config WIFI_AUTH_WPA2_PSK
                bool "WPA2 PSK"
            config WIFI_AUTH_WPA_WPA2_PSK
                bool "WPA/WPA2 PSK"
            config WIFI_AUTH_WPA3_PSK
                bool "WPA3 PSK"
            config WIFI_AUTH_WPA2_WPA3_PSK
                bool "WPA2/WPA3 PSK"
            config WIFI_AUTH_WAPI_PSK
                bool "WAPI PSK"
        endchoice

    endmenu

    menu "AHT20"

        config AHT20_SCL_GPIO
            int "SCL GPIO Num"
            default 22
            help
                GPIO number for AHT20 clock line.

        config AHT20_SDA_GPIO
            int "SDA GPIO Num"
            default 21
            help
                GPIO number for AHT20 data line.

        config AHT20_SCL_FREQ_HZ
            int "I2C Frequency Hz"
            default 100000
            help
                I2C Frequency Hz.

    endmenu

endmenu
```

## firmware/sdkconfig.defaults
```kconfig
CONFIG_ESP_WIFI_SOFTAP_SUPPORT=n
CONFIG_LWIP_SNTP_MAX_SERVERS=2
CONFIG_LWIP_SNTP_UPDATE_DELAY=3600000
```
